#include "tftlcd.h"



static  unsigned char ascii_1608[95][16]={	
{0x00,0x00,0x00,0x00,0x00,0x00,0x00,0x00,0x00,0x00,0x00,0x00,0x00,0x00,0x00,0x00},/*" ",0*/
{0x00,0x00,0x00,0x00,0x00,0x00,0x1F,0xCC,0x00,0x0C,0x00,0x00,0x00,0x00,0x00,0x00},/*"!",1*/
{0x00,0x00,0x08,0x00,0x30,0x00,0x60,0x00,0x08,0x00,0x30,0x00,0x60,0x00,0x00,0x00},/*""",2*/
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{0x00,0x00,0x60,0x00,0x80,0x00,0x80,0x00,0x40,0x00,0x40,0x00,0x20,0x00,0x20,0x00},/*"~",94*/
};  


struct chinese hz[]=
{

"仇",0x00,0x00,0x00,0x00,0x00,0x00,0x00,0x00,0x00,0x00,0x00,0x00,0x00,0x00,0x00,0x00,
0x00,0x00,0x00,0x00,0x00,0x00,0x00,0x00,0x00,0x00,0x00,0x00,0x00,0x00,0x00,0x00,
0x00,0x18,0xE0,0x00,0x00,0xF8,0xE0,0x00,0x7F,0xF0,0xE0,0x00,0x7F,0xCC,0xFF,0x00,
0x3F,0x9F,0xFF,0x80,0x19,0x9F,0xFF,0x00,0x01,0x98,0xE6,0x00,0x01,0x80,0xC6,0x00,
0x01,0x80,0xC6,0x00,0x01,0x81,0xCE,0x00,0x01,0x81,0xCE,0x00,0x01,0x83,0x8E,0x00,
0x01,0x83,0x8E,0x00,0x01,0x87,0x0F,0x00,0x01,0x8F,0x0F,0x02,0x01,0xBE,0x07,0xFE,
0x01,0xF8,0x07,0xFE,0x01,0x80,0x03,0xFC,0x01,0x80,0x00,0xF8,0x00,0x00,0x00,0x00,
0x00,0x00,0x00,0x00,0x00,0x00,0x00,0x00,0x00,0x00,0x00,0x00,0x00,0x00,0x00,0x00,/*"齐",0*/

	
"志",0x00,0x00,0x00,0x00,0x00,0x00,0x00,0x00,0x00,0x00,0x00,0x00,0x00,0x00,0x00,0x00,
0x00,0x00,0x00,0x00,0x00,0x00,0x00,0x00,0x00,0x00,0x00,0x00,0x00,0x03,0x00,0x00,
0x00,0x03,0x80,0x00,0x00,0x03,0x80,0x00,0x00,0x03,0x80,0x00,0x07,0xFF,0xFF,0xE0,
0x0F,0xFF,0xFF,0xE0,0x0C,0x03,0x80,0x00,0x00,0x03,0x80,0x00,0x01,0xFF,0xFF,0x80,
0x03,0xFF,0xFF,0x80,0x01,0x00,0x80,0x00,0x00,0x81,0xCC,0x00,0x09,0xE1,0x9E,0x00,
0x19,0xF9,0x1C,0x00,0x18,0x3E,0x38,0x00,0x38,0x07,0xE0,0x00,0x78,0x01,0xF8,0x06,
0x70,0x00,0x7F,0xFE,0x70,0x00,0x1F,0xF8,0x00,0x00,0x07,0xF0,0x00,0x00,0x01,0xC0,
0x00,0x00,0x00,0x00,0x00,0x00,0x00,0x00,0x00,0x00,0x00,0x00,0x00,0x00,0x00,0x00,/*"师",0*/
	
"鹏",0x00,0x00,0x00,0x00,0x00,0x00,0x00,0x00,0x00,0x00,0x00,0x00,0x00,0x00,0x00,0x00,
0x00,0x00,0x00,0x00,0x00,0x00,0x00,0x00,0x00,0x00,0x00,0x00,0x00,0x00,0x04,0x00,
0x00,0x00,0x0C,0x00,0x00,0x00,0x0C,0x00,0x0F,0xBE,0x7F,0xE0,0x0F,0xBE,0xFF,0xE0,
0x0D,0xB6,0x60,0xE0,0x0D,0xB6,0x6C,0xC0,0x0F,0xBE,0x6C,0xC0,0x0F,0xBE,0x67,0xC0,
0x0C,0xB6,0x63,0xC0,0x0C,0xB6,0x67,0x80,0x0F,0xBE,0x60,0x18,0x0F,0xB6,0x7F,0xFC,
0x0D,0xB6,0x60,0x1C,0x0D,0xA6,0x40,0x1C,0x19,0xE6,0xFF,0xDC,0x38,0xE7,0xC0,0x18,
0x79,0xC6,0x00,0x38,0xF1,0x86,0x07,0xF8,0x00,0x00,0x03,0xF0,0x00,0x00,0x00,0x00,
0x00,0x00,0x00,0x00,0x00,0x00,0x00,0x00,0x00,0x00,0x00,0x00,0x00,0x00,0x00,0x00,/*"鹏",0*/
	
		
};


static void TFTLCD_GPIO_Config()
{
	GPIO_InitTypeDef GPIO_Initstruct;
	
	/*控制信号引脚*/
	RCC_APB2PeriphClockCmd(LCD_CS_CLK|LCD_BK_CLK|LCD_RD_CLK|LCD_WR_CLK|LCD_DC_CLK,ENABLE);
	
	GPIO_Initstruct.GPIO_Mode=GPIO_Mode_AF_PP;
	GPIO_Initstruct.GPIO_Pin=LCD_CS_PIN;
	GPIO_Initstruct.GPIO_Speed=GPIO_Speed_50MHz;
	GPIO_Init(LCD_CS_PORT,&GPIO_Initstruct);
	
	GPIO_Initstruct.GPIO_Pin=LCD_RD_PIN;
	GPIO_Init(LCD_RD_PORT,&GPIO_Initstruct);
	
	GPIO_Initstruct.GPIO_Pin=LCD_WR_PIN;
	GPIO_Init(LCD_WR_PORT,&GPIO_Initstruct);
	
	GPIO_Initstruct.GPIO_Pin=LCD_DC_PIN;
	GPIO_Init(LCD_DC_PORT,&GPIO_Initstruct);
	/*数据线引脚*/
	RCC_APB2PeriphClockCmd(RCC_APB2Periph_GPIOD|RCC_APB2Periph_GPIOE,ENABLE);
	
	GPIO_Initstruct.GPIO_Pin=LCD_D0_PIN;
	GPIO_Init(LCD_D0_PORT,&GPIO_Initstruct);
	
	GPIO_Initstruct.GPIO_Pin=LCD_D1_PIN;
	GPIO_Init(LCD_D1_PORT,&GPIO_Initstruct);
	
	GPIO_Initstruct.GPIO_Pin=LCD_D2_PIN;
	GPIO_Init(LCD_D2_PORT,&GPIO_Initstruct);
	
	GPIO_Initstruct.GPIO_Pin=LCD_D3_PIN;
	GPIO_Init(LCD_D3_PORT,&GPIO_Initstruct);
	
	GPIO_Initstruct.GPIO_Pin=LCD_D4_PIN;
	GPIO_Init(LCD_D4_PORT,&GPIO_Initstruct);
	
	GPIO_Initstruct.GPIO_Pin=LCD_D5_PIN;
	GPIO_Init(LCD_D5_PORT,&GPIO_Initstruct);
	
	GPIO_Initstruct.GPIO_Pin=LCD_D6_PIN;
	GPIO_Init(LCD_D6_PORT,&GPIO_Initstruct);
	
	GPIO_Initstruct.GPIO_Pin=LCD_D7_PIN;
	GPIO_Init(LCD_D7_PORT,&GPIO_Initstruct);
	
	GPIO_Initstruct.GPIO_Pin=LCD_D8_PIN;
	GPIO_Init(LCD_D8_PORT,&GPIO_Initstruct);
	
	GPIO_Initstruct.GPIO_Pin=LCD_D9_PIN;
	GPIO_Init(LCD_D9_PORT,&GPIO_Initstruct);
	
	GPIO_Initstruct.GPIO_Pin=LCD_D10_PIN;
	GPIO_Init(LCD_D10_PORT,&GPIO_Initstruct);
	
	GPIO_Initstruct.GPIO_Pin=LCD_D11_PIN;
	GPIO_Init(LCD_D11_PORT,&GPIO_Initstruct);
	
	GPIO_Initstruct.GPIO_Pin=LCD_D12_PIN;
	GPIO_Init(LCD_D12_PORT,&GPIO_Initstruct);
	
	GPIO_Initstruct.GPIO_Pin=LCD_D13_PIN;
	GPIO_Init(LCD_D13_PORT,&GPIO_Initstruct);
	
	GPIO_Initstruct.GPIO_Pin=LCD_D14_PIN;
	GPIO_Init(LCD_D14_PORT,&GPIO_Initstruct);
	
	GPIO_Initstruct.GPIO_Pin=LCD_D15_PIN;
	GPIO_Init(LCD_D15_PORT,&GPIO_Initstruct);
	
	
	GPIO_Initstruct.GPIO_Pin=LCD_BK_PIN;
	GPIO_Initstruct.GPIO_Mode=GPIO_Mode_Out_PP;
	GPIO_Initstruct.GPIO_Speed=GPIO_Speed_50MHz;
	GPIO_Init(LCD_BK_PORT,&GPIO_Initstruct);
	
	LCD_BK=1;
}

static void TFTLCD_Mode_Config()
{
	FSMC_NORSRAMInitTypeDef FSMC_NORSRAMInitstruct;
	FSMC_NORSRAMTimingInitTypeDef FSMC_ReadTimingstruct;
	FSMC_NORSRAMTimingInitTypeDef FSMC_WriteTimingstruct;
	RCC_AHBPeriphClockCmd(RCC_AHBPeriph_FSMC,ENABLE);
	
	FSMC_ReadTimingstruct.FSMC_AccessMode=FSMC_AccessMode_A;
	FSMC_ReadTimingstruct.FSMC_AddressHoldTime=0x00;
	FSMC_ReadTimingstruct.FSMC_AddressSetupTime=0x01;
	FSMC_ReadTimingstruct.FSMC_BusTurnAroundDuration=0x00;
	FSMC_ReadTimingstruct.FSMC_CLKDivision=0x00;
	FSMC_ReadTimingstruct.FSMC_DataLatency=0x00;
	FSMC_ReadTimingstruct.FSMC_DataSetupTime=0x0f;
	
	FSMC_WriteTimingstruct.FSMC_AccessMode=FSMC_AccessMode_A;
	FSMC_WriteTimingstruct.FSMC_AddressHoldTime=0x15;
	FSMC_WriteTimingstruct.FSMC_AddressSetupTime=0x15;
	FSMC_WriteTimingstruct.FSMC_BusTurnAroundDuration=0x00;
	FSMC_WriteTimingstruct.FSMC_CLKDivision=0x00;
	FSMC_WriteTimingstruct.FSMC_DataLatency=0x00;
	FSMC_WriteTimingstruct.FSMC_DataSetupTime=0x05;
	
	
	FSMC_NORSRAMInitstruct.FSMC_WriteOperation=FSMC_WriteOperation_Enable;
	FSMC_NORSRAMInitstruct.FSMC_Bank=FSMC_Bank1_NORSRAM4;
	FSMC_NORSRAMInitstruct.FSMC_ExtendedMode=FSMC_ExtendedMode_Enable;
	FSMC_NORSRAMInitstruct.FSMC_MemoryDataWidth=FSMC_MemoryDataWidth_16b;
	FSMC_NORSRAMInitstruct.FSMC_MemoryType=FSMC_MemoryType_SRAM;
	
	
	FSMC_NORSRAMInitstruct.FSMC_BurstAccessMode=FSMC_BurstAccessMode_Disable;
	FSMC_NORSRAMInitstruct.FSMC_DataAddressMux=FSMC_DataAddressMux_Disable;
	FSMC_NORSRAMInitstruct.FSMC_WaitSignal=FSMC_WaitSignal_Disable;
	FSMC_NORSRAMInitstruct.FSMC_WaitSignalActive=FSMC_WaitSignalActive_BeforeWaitState;
	FSMC_NORSRAMInitstruct.FSMC_WaitSignalPolarity=FSMC_WaitSignalPolarity_Low;
	FSMC_NORSRAMInitstruct.FSMC_WrapMode=FSMC_WrapMode_Disable;
	FSMC_NORSRAMInitstruct.FSMC_WriteBurst=FSMC_WriteBurst_Disable;
	FSMC_NORSRAMInitstruct.FSMC_AsynchronousWait=FSMC_AsynchronousWait_Disable;
	
	
	FSMC_NORSRAMInitstruct.FSMC_WriteTimingStruct=&FSMC_WriteTimingstruct;
	FSMC_NORSRAMInitstruct.FSMC_ReadWriteTimingStruct=&FSMC_ReadTimingstruct;
	
	FSMC_NORSRAMInit(&FSMC_NORSRAMInitstruct);
	FSMC_NORSRAMCmd(FSMC_Bank1_NORSRAM4,ENABLE);
}


void LCD_WriteCmd(u16 cmd)
{
	W_CMD=cmd;
}

void LCD_WriteData(u16 data)
{
	W_DATA=data;
}

void TFTLCD_Init()
{
	u16 tmp=0;
	TFTLCD_GPIO_Config();
	TFTLCD_Mode_Config();
	
	
	
	delay_ms(20);
	LCD_WriteCmd(0xda);
	tmp=W_DATA;
	tmp=W_DATA<<8;
	LCD_WriteCmd(0xdb);
	tmp|=W_DATA;
	tmp|=W_DATA;
	printf("LCD ID:0x%x\r\n",tmp);
	
	LCD_WriteCmd(0xE0); //P-Gamma
	LCD_WriteData(0x00);
	LCD_WriteData(0x13);
	LCD_WriteData(0x18);
	LCD_WriteData(0x04);
	LCD_WriteData(0x0F);
	LCD_WriteData(0x06);
	LCD_WriteData(0x3A);
	LCD_WriteData(0x56);
	LCD_WriteData(0x4D);
	LCD_WriteData(0x03);
	LCD_WriteData(0x0A);
	LCD_WriteData(0x06);
	LCD_WriteData(0x30);
	LCD_WriteData(0x3E);
	LCD_WriteData(0x0F);
	
	LCD_WriteCmd(0XE1); //N-Gamma
	LCD_WriteData(0x00);
	LCD_WriteData(0x13);
	LCD_WriteData(0x18);
	LCD_WriteData(0x01);
	LCD_WriteData(0x11);
	LCD_WriteData(0x06);
	LCD_WriteData(0x38);
	LCD_WriteData(0x34);
	LCD_WriteData(0x4D);
	LCD_WriteData(0x06);
	LCD_WriteData(0x0D);
	LCD_WriteData(0x0B);
	LCD_WriteData(0x31);
	LCD_WriteData(0x37);
	LCD_WriteData(0x0F); 
	
	LCD_WriteCmd(0XC0);   //Power Control 1
	LCD_WriteData(0x18); //Vreg1out
	LCD_WriteData(0x17); //Verg2out
	
	LCD_WriteCmd(0xC1);   //Power Control 2
	LCD_WriteData(0x41); //VGH,VGL
	
	LCD_WriteCmd(0xC5);   //Power Control 3
	LCD_WriteData(0x00);
	LCD_WriteData(0x1A); //Vcom
	LCD_WriteData(0x80);
	
	LCD_WriteCmd(0x36);   //Memory Access
	LCD_WriteData(0x08);   //48
	
	LCD_WriteCmd(0x3A);   // Interface Pixel Format
	LCD_WriteData(0x55); //16bit
	
	LCD_WriteCmd(0XB0);   // Interface Mode Control
	LCD_WriteData(0x00);
	
	LCD_WriteCmd(0xB1);   //Frame rate
	LCD_WriteData(0xA0); //60Hz
	
	LCD_WriteCmd(0xB4);   //Display Inversion Control
	LCD_WriteData(0x02); //2-dot
	
	LCD_WriteCmd(0XB6);   //RGB/MCU Interface Control
//	LCD_WriteData(0x02); //MCU RGB
//	LCD_WriteData(0x02); //Source,Gate scan dieection
	LCD_WriteData(0x00);
	LCD_WriteData(0x22);//0 GS SS SM ISC[3:0];其中GS SS控制显示方向，同时修改R36
	LCD_WriteData(0x3B);
	
	LCD_WriteCmd(0XE9);    // Set Image Function
	LCD_WriteData(0x00);  //disable 24 bit data input
	
	LCD_WriteCmd(0xF7);    // Adjust Control
	LCD_WriteData(0xA9);
	LCD_WriteData(0x51);
	LCD_WriteData(0x2C);
	LCD_WriteData(0x82);  // D7 stream, loose
	
	LCD_WriteCmd(0x11);    //Sleep out
	delay_ms(120);
	LCD_WriteCmd(0x29);  
	LCD_WriteCmd(0x2C);
	
	TFTLCD_Set_dir(0);
	
	FULL_COloc(0xffff);
}

//0:竖屏  1:横屏
void TFTLCD_Set_dir(u8 dir)
{
	if(dir)
	{
		LCD_WriteCmd(0x36);
		LCD_WriteData(0x28);
		LCD_WriteCmd(0xb6);
		LCD_WriteData(0x00);
		LCD_WriteData(0x02);
		LCD_WriteData(0x3b);
	}
	else
	{
		LCD_WriteCmd(0x36);
		LCD_WriteData(0x08);
	}
}

void FULL_COloc(u16 color)
{
	int tt=320*480;
	LCD_WriteCmd(0x2a);
	LCD_WriteData(0x00);
	LCD_WriteData(0x00);
	LCD_WriteData(0x01);
	LCD_WriteData(0x3f);
	
	LCD_WriteCmd(0x2b);
	LCD_WriteData(0x00);
	LCD_WriteData(0x00);
	LCD_WriteData(0x01);
	LCD_WriteData(0xdf);
	
	LCD_WriteCmd(0x2c);
	
	while(tt--)
	{
		LCD_WriteData((color>>8)&0xff);
		LCD_WriteData(color&0xff);
	}
	
}
//建立窗口
void TFTLCD_Set_Window(u16 x,u16 y,u16 width,u16 heigh)
{
	LCD_WriteCmd(0x2a);
	LCD_WriteData(x/256);
	LCD_WriteData(x%256);
	LCD_WriteData((width)/256);
	LCD_WriteData((width)%256);
	
	LCD_WriteCmd(0x2b);
	LCD_WriteData(y/256);
	LCD_WriteData(y%256);
	LCD_WriteData((heigh)/256);
	LCD_WriteData((heigh)%256);
	LCD_WriteCmd(0x2c);
}
//画矩形
void TFTLCD_Rectangle(u16 x,u16 y,u16 width,u16 heigh,u16 color)
{
	u16 i=0;
	u16 area=(x+width)*(y+heigh);
	TFTLCD_Set_Window(x,y,x+width,y+heigh);
	for(i=0;i<area;i++)
	{
		LCD_WriteData((color>>8)&0xff);
		LCD_WriteData(color&0xff);
		delay_ms(50);
	}
}
//描点
void TFTLCD_Dot(u16 x,u16 y,u16 color)
{
	TFTLCD_Set_Window(x,y,x,y);
	LCD_WriteData((color>>8)&0xff);
	LCD_WriteData(color&0xff);
}

void LCD_Write_color(u16 color)
{
	LCD_WriteData((color>>8)&0xff);
	LCD_WriteData(color&0xff);
}

//画线
void TFTLCD_Line(u16 col,u16 row,u16 len,u16 color)
{
	u16 i=0;
	if((col+len)>320&&(row>480))
	{
		return;
	}
	for(i=col;i<(col+len);i++)
	{
		TFTLCD_Dot(i,row,color);
	}
}


//画斜线直线
void TFTLCD_Draw_Line(u16 x1,u16 y1,u16 x2,u16 y2,u16 color)
{
	u16 i=0;
	int delat_x=0,delat_y=0,xerr=0,yerr=0;
	int urow=x1,ucol=y1;
	int distance=0;
	int incx=0,incy=0;
	delat_x=x2-x1;
	delat_y=y2-y1;
	if(delat_x>0)
		incx=1;
	else if(delat_x==0)
		incx=0;
	else
		incx=-1;
	
	if(delat_y>0)
		incy=1;
	else if(delat_y==0)
		incy=0;
	else
		incy=-1;
	if(delat_x>delat_y)
		distance=delat_x;
	else
		distance=delat_y;
	for(i=0;i<=distance+1;i++)
	{
		TFTLCD_Dot(urow,ucol,color);
		xerr+=delat_x;
		yerr+=delat_y;
		if(xerr>distance)
		{
			xerr-=distance;
			urow+=incx;
		}
		if(yerr>distance)
		{
			yerr-=distance;
			ucol+=incy;
		}
	}
	
}

//画园
void LCD_Draw_Circle(u16 x0,u16 y0,u8 r)
{
	int a,b;
	int di;
	a=0;b=r;	  
	di=3-(r<<1);             //判断下个点位置的标志
	while(a<=b)
	{
		TFTLCD_Dot(x0+a,y0-b,BLACK);             //5
 		TFTLCD_Dot(x0+b,y0-a,BLACK);             //0           
		TFTLCD_Dot(x0+b,y0+a,BLACK);             //4               
		TFTLCD_Dot(x0+a,y0+b,BLACK);             //6 
		TFTLCD_Dot(x0-a,y0+b,BLACK);             //1       
 		TFTLCD_Dot(x0-b,y0+a,BLACK);             
		TFTLCD_Dot(x0-a,y0-b,BLACK);             //2             
  		TFTLCD_Dot(x0-b,y0-a,BLACK);             //7     	         
		a++;
		//使用Bresenham算法画圆     
		if(di<0)di +=4*a+6;	  
		else
		{
			di+=10+4*(a-b);   
			b--;
		}
		delay_ms(20);
	}
} 

void TFTLCD_Show_Char(u16 x,u16 y,u8 ch,u8 size,u8 mode)
{
	u8 tmp=0;
	u8 i=0;
	u8 j=0;
	u16 y0=y;
	u8 csize=(size/8+((size%8)?1:0))*(size/2);
	ch=ch-' ';
	for(i=0;i<csize;i++)
	{
		tmp=ascii_1608[ch][i];
		for(j=0;j<8;j++)
		{
			if(tmp&0x80)
			{
				TFTLCD_Dot(x,y,BLACK);
			}
			else if(mode==0)
			{
				TFTLCD_Dot(x,y,WHITE);
			}
			tmp<<=1;
			y++;
			if(y>=480)
			{
				return;
			}
			if((y-y0)==size)
			{
				y=y0;
				x++;
				if(x>=320)
				{
					return;
				}
				break;
			}
		}
	}
}

void TFTLCD_Show_String(u16 x,u16 y,u8* str,u8 size)
{
	u16 x0=x;
	while(*str!='\0')
	{
		TFTLCD_Show_Char(x,y,*str,size,0);
		str++;
		x+=size/2;
		if(x>=320)
		{
			x=x0;
			y+=size;
		}
		if(y>=480)
		{
			break;
		}
	}
}



void TFTLCD_Show_HZ(u16 x,u16 y,u8* cn)
{
	u16 row=0;
	u16 byte=0;
	u16 x0=x;
	u16 y0=y;
	u8 bit=0;
	u8 data=0;
	u8 wordnum=0;
	while(*cn!='\0')
	{
		if((hz[wordnum].hz[0]==*cn)&&(hz[wordnum].hz[1]==*(cn+1)))
		{
			for(row=0;row<32;row++)
			{
				for(byte=0;byte<4;byte++)
				{
					data=hz[wordnum].data[row*4+byte];
					for(bit=0;bit<8;bit++)
					{
						if(data&(0x80>>bit))
						{
							TFTLCD_Dot(x,y,BLACK);
						}
						else
						{
							TFTLCD_Dot(x,y,WHITE);
						}
						x++;
						if((x-x0)==32)
						{
							x=x0;
							y++;
							if((y-y0)==32)
							{
								y=y0;
							}
						}
					}
				}
			}
		}
		x+=32;
		x0=x;
		wordnum++;
		cn+=2;
	}
}

u16 TFTLCD_Pow(u16 x,u16 y)
{
	u16 tmp=1;
	while(y--)
	{
		tmp*=x;
	}
	return tmp;
}

void TFTLCD_Show_NUM(u16 x,u16 y,u16 num,u8 len)
{
	u8 i=0;
	for(i=0;i<len;i++)
	{
		TFTLCD_Show_Char(x,y,(num/TFTLCD_Pow(10,len-1-i)%10)+'0',16,0);
		x+=8;
	}
}

void TFTLCD_Show_HEX(u16 x,u16 y,u16 num,u8 len)
{
	u8 i=0;
	u16 tmp=0;
	for(i=0;i<len;i++)
	{
		tmp=(num/TFTLCD_Pow(16,len-1-i)%16);
		printf("HEX:%d\r\n",tmp);
		if(tmp>9)
		{
			tmp+='7';
		}
		else
		{
			tmp+='0';
		}
		TFTLCD_Show_Char(x,y,tmp,16,0);
		x+=8;
	}
}

void TFTLCD_Fill_dot(u16 xsta,u16 ysta,u16 xend,u16 yend,u16 color)
{
	if((xsta>xend)||(ysta>yend))
	{
		return;
	}
	TFTLCD_Set_Window(xsta,ysta,xend,yend);
	u16 xtmp=xend-xsta+1;
	u16 ytmp=yend-ysta+1;
	while(xtmp--)
	{
		while(ytmp--)
		{
			LCD_Write_color(color);
		}
	}
}